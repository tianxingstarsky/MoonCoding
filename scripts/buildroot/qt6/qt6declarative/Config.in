## scripts/buildroot/qt6/qt6declarative/Config.in
```kconfig
config BR2_PACKAGE_QT6DECLARATIVE
	bool "qt6declarative"
	select BR2_PACKAGE_QT6SHADERTOOLS
	select BR2_PACKAGE_QT6BASE_GUI
	select BR2_PACKAGE_QT6BASE_NETWORK
	help
	  Qt Declarative / Quick (QML). Required by Qt WebEngine even
	  when using QWebEngineView (Widgets).

	  https://doc.qt.io/qt-6/qtdeclarative-index.html
```

## scripts/buildroot/qt6/qt6shadertools/Config.in
```kconfig
config BR2_PACKAGE_QT6SHADERTOOLS
	bool "qt6shadertools"
	select BR2_PACKAGE_QT6BASE_GUI
	help
	  Qt Shader Tools provides tools for the cross-platform Qt
	  shader pipeline. Required by Qt Declarative / Quick.

	  https://doc.qt.io/qt-6/qtshadertools-index.html
```

## scripts/buildroot/qt6/qt6webchannel/Config.in
```kconfig
config BR2_PACKAGE_QT6WEBCHANNEL
	bool "qt6webchannel"
	select BR2_PACKAGE_QT6BASE_NETWORK
	help
	  Qt WebChannel enables peer-to-peer communication between a
	  server (QML/C++ application) and a client (HTML/JavaScript or
	  QML application).

	  Required by Qt WebEngine.

	  https://doc.qt.io/qt-6/qtwebchannel-index.html
```

## scripts/buildroot/qt6/qt6webengine/Config.in
```kconfig
config BR2_PACKAGE_QT6WEBENGINE
	bool "qt6webengine"
	depends on BR2_PACKAGE_QT6_ARCH_SUPPORTS
	depends on BR2_TOOLCHAIN_GCC_AT_LEAST_8
	depends on BR2_HOST_GCC_AT_LEAST_8
	depends on BR2_PACKAGE_HOST_NODEJS
	select BR2_PACKAGE_QT6WEBCHANNEL
	select BR2_PACKAGE_QT6BASE_GUI
	select BR2_PACKAGE_QT6BASE_WIDGETS
	select BR2_PACKAGE_QT6BASE_NETWORK
	select BR2_PACKAGE_LIBNSS
	select BR2_PACKAGE_LIBXML2
	select BR2_PACKAGE_LIBXSLT
	select BR2_PACKAGE_JPEG
	select BR2_PACKAGE_LIBPNG
	select BR2_PACKAGE_FREETYPE
	select BR2_PACKAGE_FONTCONFIG
	select BR2_PACKAGE_ZLIB
	help
	  Qt WebEngine provides a web browser engine based on Chromium
	  for embedding HTML/CSS/JS content (QWebEngineView).

	  Very large build (Chromium). Needs host nodejs/ninja/python.
	  Intended for MoonCoding board HTML preview; may be heavy on
	  512MB-class devices — keep as optional.

	  https://doc.qt.io/qt-6/qtwebengine-index.html

comment "qt6webengine needs host nodejs"
	depends on !BR2_PACKAGE_HOST_NODEJS
	depends on BR2_PACKAGE_QT6
```
